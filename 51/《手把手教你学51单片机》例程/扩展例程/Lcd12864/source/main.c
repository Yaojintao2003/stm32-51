/*
*******************************************************************************
*                     《手把手教你学51单片机(C语言版)》
*                    配套 KST-51 单片机开发板 示例源代码
*
*         (c) 版权所有 2014 金沙滩工作室/清华大学出版社 保留所有权利
*                 获取更多资料请访问：http://www.kingst.org
*
* 文件名：main.c
* 描  述：12864点阵液晶测试 工程主文件
* 版本号：v1.0.0
* 备  注：
*******************************************************************************
*/

#define _MAIN_C
#include "config.h"
#include "Lcd12864.h"
#include "main.h"


bit flag1s = 0;  //1s定时标志

void main()
{
    EA = 1;          //使能总中断
    InitSysTimer();  //配置系统定时器
    InitLcd12864();  //初始化液晶
    StartScreen();   //显示启动画面
    
    while (1)
    {
        if (flag1s)  //间隔1s执行测试演示
        {
            flag1s = 0;
            Lcd12864Demo();
        }
    }
}

/* 长整型数转换为字符串，str-字符串指针，dat-待转换数，返回值-字符串长度 */
unsigned char LongToString(unsigned char *str, signed long dat)
{
    signed char i = 0;
    unsigned char len = 0;
    unsigned char buf[12];
    
    if (dat < 0)  //如果为负数，首先取绝对值，并在指针上添加负号
    {
        dat = -dat;
        *str++ = '-';
        len++;
    }
    do {          //先转换为低位在前的十进制数组
        buf[i++] = dat % 10;
        dat /= 10;
    } while (dat > 0);
    len += i;     //i最后的值就是有效字符的个数
    while (i-- > 0)   //将数组值转换为ASCII码反向拷贝到接收指针上
    {
        *str++ = buf[i] + '0';
    }
    *str = '\0';  //添加字符串结束符
    
    return len;   //返回字符串长度
}
/* 显示启动屏幕 */
void StartScreen()
{
    const uint8 code welcome[] = {
        0x00, 0x00, 0x00, 0x00, 0x00, 0x00, 0x00, 0x00, 0x00, 0x00, 0x00, 0x00, 0x00, 0x00, 0x00, 0x00,
        0x00, 0x00, 0x00, 0x00, 0x00, 0x00, 0x00, 0x00, 0x00, 0x00, 0x00, 0x00, 0x00, 0x00, 0x00, 0x00,
        0x00, 0x00, 0x00, 0x00, 0x00, 0x00, 0x00, 0x00, 0x00, 0x00, 0x00, 0x00, 0x00, 0x00, 0x00, 0x00,
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        0x00, 0x00, 0x00, 0x00, 0x00, 0x00, 0x00, 0x00, 0x00, 0x00, 0x00, 0x00, 0x00, 0x00, 0x00, 0x00,
    };

    LcdShowImage(16, 0, 96, 32, welcome);
    LcdShowString(16, 32, "金沙滩工作室");
    LcdShowString(0, 48, " www.kingst.org ");
}
/* 图形演示函数 */
void GraphicsDemo()
{
    static bit flg = 0;
    const uint8 code img1[] = {
        0xFF, 0xFF, 0xFF, 0xFF, 0xFF, 0xFF, 0xFF, 0xFF, 0xFF, 0xFF, 0xFF, 0xFF, 0xFF, 0xFF, 0xFF, 0xFF,
        0x80, 0x00, 0x00, 0x00, 0x00, 0x00, 0x00, 0x00, 0x00, 0x00, 0x00, 0x00, 0x00, 0x00, 0x00, 0x01,
        0x80, 0x00, 0x00, 0x00, 0x00, 0x00, 0x00, 0x00, 0x00, 0x01, 0x00, 0x00, 0x00, 0x00, 0x00, 0x01,
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        0xFF, 0xFF, 0xFF, 0xFF, 0xFF, 0xFF, 0xFF, 0xFF, 0xFF, 0xFF, 0xFF, 0xFF, 0xFF, 0xFF, 0xFF, 0xFF,
    };
    const uint8 code img2[] = {
        0x00, 0x00, 0x3D, 0x55, 0x00, 0x00, 0x00, 0x00, 0x00, 0x00, 0x00, 0x00, 0xAA, 0xBC, 0x00, 0x00,
        0x00, 0x00, 0x3A, 0xAA, 0x00, 0x00, 0x00, 0x00, 0x00, 0x00, 0x00, 0x00, 0x55, 0x5C, 0x00, 0x00,
        0x00, 0x00, 0x3D, 0x54, 0x00, 0x60, 0x06, 0x00, 0x00, 0x04, 0x00, 0x00, 0x2A, 0xBC, 0x00, 0x00,
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        0x00, 0x00, 0x3D, 0x55, 0x00, 0x00, 0x00, 0x00, 0x00, 0x00, 0x00, 0x00, 0xAA, 0xBC, 0x00, 0x00,
    };

    if (flg == 0)
    {
        flg = 1;
        LcdShowImage(0, 32, 128, 32, img1);
    }
    else
    {
        flg = 0;
        LcdShowImage(0, 32, 128, 32, img2);
    }
}
/* 12864液晶演示函数 */
void Lcd12864Demo()
{
    uint8 len;
    uint8 str[12];
    static uint8 refresh = 0;
    static uint16 runtime = 0;
    
    runtime++;
    if (runtime == 3)  //第3秒切换到演示画面
    {
        //清除原显示内容
        LcdClearArea(0, 0, 128, 64);
        LcdShowString(0, 32, "                ");
        LcdShowString(0, 48, "                ");
        //初始化演示屏幕
        LcdShowString(16, 0, "字符显示演示");
        LcdShowString(0, 16, " Run Time:3s");
        GraphicsDemo();
    }
    if (runtime > 3)  //3秒后循环刷新演示画面
    {
        //刷新字符演示，显示运行时间
        len = LongToString(str, runtime);
        str[len++] = 's';
        str[len] = '\0';
        LcdShowString(10*8, 16, str);
        //属性图形演示
        if (++refresh >= 3)
        {
            refresh = 0;
            GraphicsDemo();
        }
    }
}
/* 系统定时器初始化，配置T0定时10ms */
void InitSysTimer()
{
    TMOD &= 0xF0;   //清零T0的控制位
    TMOD |= 0x01;   //配置T0为模式1
    TH0   = (65536-SYS_MCLK/100) >> 8;
    TL0   = (65536-SYS_MCLK/100);
	ET0   = 1;      //使能T0中断
	TR0   = 1;      //启动T0
}
/* T0定时中断服务函数 */
void Timer0_ISR() interrupt 1
{
    static uint8 tmr1s = 0;
    
    //T0重新赋初值
    TH0 = (65536-SYS_MCLK/100) >> 8;
    TL0 = (65536-SYS_MCLK/100);
    //1s定时
    tmr1s++;
    if (tmr1s >= 100)
    {
        tmr1s = 0;
        flag1s = 1;
    }
}
